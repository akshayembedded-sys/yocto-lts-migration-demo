## meta-demo/conf/layer.conf
```bitbake
# SPDX-License-Identifier: MIT
BBPATH .= ":${LAYERDIR}"

BBFILES += "${LAYERDIR}/recipes-*/*/*.bb \
            ${LAYERDIR}/recipes-*/*/*.bbappend"

BBFILE_COLLECTIONS += "demo"
BBFILE_PATTERN_demo = "^${LAYERDIR}/"
BBFILE_PRIORITY_demo = "10"

LAYERDEPENDS_demo = "core"
LAYERSERIES_COMPAT_demo = "kirkstone"
```
